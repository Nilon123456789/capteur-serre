## sample.yaml
```
sample:
  name: broadcaster
tests:
  sample.bluetooth.broadcaster:
    harness: bluetooth
    tags: bluetooth
```

## prj.conf
```kconfig
# Enable ADC support #
CONFIG_ADC=y
CONFIG_ADC_ASYNC=y

# Enable GPIO support #
CONFIG_GPIO=y

# Enable i2c support #
CONFIG_I2C=y

# Enable support for log
CONFIG_NEWLIB_LIBC=y # TODO : optimize this

#BLE config
CONFIG_BT=y
CONFIG_BT_EXT_ADV=y
CONFIG_BT_BROADCASTER=y
CONFIG_BT_DEVICE_NAME="LRIMa test 1" #Change this for each device

# Low power config
CONFIG_PM=y
CONFIG_PM_DEVICE=y
CONFIG_PM_DEVICE_RUNTIME=y

#Custom configs
CONFIG_SENSOR_SLEEP_DURATION_SEC=600
CONFIG_BLE_ADV_DURATION_SEC=1
CONFIG_BLE_MIN_ADV_INTERVAL_MS=30
CONFIG_BLE_MAX_ADV_INTERVAL_MS=40
CONFIG_BLE_USER_DEFINED_MAC_ADDR="f0:ca:f0:ca:01:d5" #Change this for each device 

# Enable logging support #
CONFIG_LOG=y
CONFIG_LOG_DEFAULT_LEVEL=1
CONFIG_DEBUG_OPTIMIZATIONS=y
CONFIG_LOG_PRINTK=y
CONFIG_AHT20_LOG_LEVEL_ERR=y
CONFIG_ADC_LOG_LEVEL_ERR=y
CONFIG_BT_LOG_LEVEL_OFF=y
CONFIG_BT_DEBUG_LOG=n
CONFIG_BLE_DRIVER_LOG_LEVEL_INF=y
```

## src/main.c
```c
/* main.c - Application main entry point */

/*
 * Copyright (c) 2015-2016 Intel Corporation
 *
 * SPDX-License-Identifier: Apache-2.0
 */

#include <zephyr/kernel.h>
#include <zephyr/logging/log.h>
#include "drivers/adc.h"
#include "drivers/aht20.h"
#include "drivers/ble.h"
#include "utils.h"

LOG_MODULE_REGISTER(MAIN, CONFIG_MAIN_LOG_LEVEL);

sensors_data_t sensors_data = {
	.temp = 0,
	.hum = 0,
	.lum = 0,
	.gnd_temp = 0,
	.gnd_hum = 0,
	.bat = 0
};

/**
 * @brief Read the sensors data
 */
static void read(void) {
		// Read the temperature and humidity
		RET_IF_ERR(aht20_read(&sensors_data.temp, &sensors_data.hum), "Unable to read temperature and humidity");
		// Read the luminosity
		RET_IF_ERR(luminosity_read(&sensors_data.lum), "Unable to read luminosity");
		// Read the ground temperature
		RET_IF_ERR(ground_temperature_read(&sensors_data.gnd_temp), "Unable to read ground temperature");
		// Read the ground humidity
		RET_IF_ERR(ground_humidity_read(&sensors_data.gnd_hum), "Unable to read ground humidity");
		// Read the battery level
		RET_IF_ERR(battery_voltage_read(&sensors_data.bat), "Unable to read battery level");
}

/**
 * @brief Send the sensors data
 */
static void send(void) {
	// Encode the data into the service data
	RET_IF_ERR(ble_encode_adv_data(&sensors_data), "Unable to encode data");

	// Advertise the data
	RET_IF_ERR(ble_adv(), "Unable to advertise data");
}

/**
 * @brief Main function
 */
void main(void) {
	LOG_INF("Starting application");

	// Initialize the ADC driver
	RET_IF_ERR(adc_init(), "Unable to initialize ADC");
	// Initialize the AHT20 driver
	RET_IF_ERR(aht20_init(), "Unable to initialize AHT20");
	// Initialize the BLE driver
	RET_IF_ERR(ble_init(), "Unable to initialize BLE");

	while(true) {
		// Read the sensors data
		read();

		// Send the sensors data
		send();

		// Wait
		k_sleep(K_SECONDS(CONFIG_SENSOR_SLEEP_DURATION_SEC));
	}
}
```

## src/utils.h
```c
/**
 * utils.h
 * 
 * Utility functions
 * 
 * Author: Nils Lahaye 2023
 * 
*/

#ifndef UTILS_H_
#define UTILS_H_

#include <math.h>
#include <stdint.h>

#define TO_STRING(x) #x
#define LOCATION __FILE__ ":" TO_STRING(__LINE__)

#define RET_IF_ERR(expr, msg)                                   \
    {                                                           \
        int ret = (expr);                                       \
        if(ret) {                                               \
            LOG_ERR("Error %d: " msg " in " LOCATION, ret);     \
            return ret;                                         \
        }                                                       \
    }

float mapRange(float value, float inMin, float inMax, float outMin, float outMax);

float evaluate_polynomial(float x, const int coefficients[3]);

int floatSeparator(float *val, uint8_t *whole, uint8_t *decimal);

#endif /* UTILS_H_ */
```
